## firmware/app/Kconfig
```kconfig
menu "Application Libraries"

rsource "data_ble/Kconfig"
rsource "app_mic/Kconfig"
rsource "app_ppg/Kconfig"
rsource "app_data/Kconfig"


endmenu
```

## firmware/app/app_data/Kconfig
```kconfig
menu "Data assembler application library"
menuconfig APP_DATA
	bool "Enable BLE transmission data assembler application libraries"
	default n
	help
	  Enable this option to include the BLE transmission data assembler application libraries.
endmenu
```

## firmware/app/app_mic/Kconfig
```kconfig
menu "Microphone interface with Nordic ADC application library"
menuconfig APP_MIC
	bool "Enable Nordic ADC Application libraries"
	default n
	help
	  Enable this option to include the Nordic ADC Application libraries.
endmenu
```

## firmware/app/app_ppg/Kconfig
```kconfig
menu "PPG application library"
menuconfig APP_PPG
	bool "Enable MAX30101&MAX32664 PPG Application libraries"
	default n
	help
	  Enable this option to include the PPG related Application libraries.
endmenu
```

## firmware/app/data_ble/Kconfig
```kconfig
menu "BLE Interface"

menuconfig DATA_BLE
    bool "Enable BLE interface"
    default n

endmenu
```

## firmware/boards/arm/apnea_v1/Kconfig.board
```kconfig
# Copyright (c) 2022 Nordic Semiconductor ASA
# SPDX-License-Identifier: Apache-2.0

config BOARD_APNEA_V1
	bool "apnea_v1"
	depends on SOC_NRF52840_QIAA
```

## firmware/boards/arm/apnea_v1/Kconfig.defconfig
```kconfig
# Copyright (c) 2022 Nordic Semiconductor ASA
# SPDX-License-Identifier: Apache-2.0

if BOARD_APNEA_V1

config BOARD
	default "apnea_v1"

config BT_CTLR
   default BT

endif
```

## firmware/boards/arm/apnea_v2/Kconfig.board
```kconfig
# Copyright (c) 2024 Nordic Semiconductor ASA
# SPDX-License-Identifier: Apache-2.0

config BOARD_APNEA_V2
	bool "apnea_v2"
	depends on SOC_NRF52840_QIAA
```

## firmware/boards/arm/apnea_v2/Kconfig.defconfig
```kconfig
# Copyright (c) 2024 Nordic Semiconductor ASA
# SPDX-License-Identifier: Apache-2.0

if BOARD_APNEA_V2

config BOARD
	default "apnea_v2"

config BT_CTLR
   default BT


endif
```

## firmware/drivers/Kconfig
```kconfig
menu "Custom Device Drivers"

rsource "max32664/Kconfig"

rsource "kx132/Kconfig"

rsource "nordic_adc/Kconfig"

endmenu
```

## firmware/drivers/kx132/Kconfig
```kconfig
menu "KX132 driver"

menuconfig KX132
	bool "kx132 drivers"
	default n
	depends on I2C
	help
	  Enable KX132 driver configuration.

endmenu
```

## firmware/drivers/nordic_adc/Kconfig
```kconfig
menu "Nordic ADC driver"
menuconfig NORDIC_ADC
	bool "nordic adc drivers"
	default n
	help
	  Enable nordic adc driver configuration.

endmenu
```
